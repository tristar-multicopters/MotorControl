#include "hal_data.h"

FSP_CPP_HEADER
void R_BSP_WarmStart(bsp_warm_start_event_t event);
FSP_CPP_FOOTER

#define CAN_EXAMPLE_ID                  (0x20)
#define WAIT_TIME                       (10000U) //wait time value
#define CAN_FRAME_TRANSMIT_DATA_BYTES   (8U)     //data length
#define RESET_VALUE                     (0x00)
#define ZERO                            (0U)

can_frame_t g_can_tx_frame;
can_frame_t g_can_rx_frame;


can_info_t can_info;

volatile canfd_error_t g_err_status = (canfd_error_t) 0;
void canfd0_callback (can_callback_args_t * p_args);

bool b_can_rx = false;
bool b_can_tx = false; 
bool SendResponse = false;

      //Filter list for which frame to accept
const canfd_afl_entry_t p_canfd0_afl[CANFD_CFG_AFL_CH0_RULE_NUM] =
{
    {
        .id =
        {
            // Specify the ID, ID type and frame type to accept.
            .id         = CAN_EXAMPLE_ID,
            .frame_type = CAN_FRAME_TYPE_DATA,
            .id_mode    = CAN_ID_MODE_STANDARD,
        },
        .mask =
        {
            // These values mask which ID/mode bits to compare when filtering messages. 
            .mask_id         = 0x1FFFFFFF,
            .mask_frame_type = 1,
            .mask_id_mode    = 1,
        },
        .destination =
        {
            // If DLC checking is enabled any messages shorter than the below setting will be rejected. 
            .minimum_dlc = CANFD_MINIMUM_DLC_0,
            // Optionally specify a Receive Message Buffer (RX MB) to store accepted frames. RX MBs do not have an
            //  interrupt or overwrite protection and must be checked with R_CANFD_InfoGet and R_CANFD_Read. 
            .rx_buffer   = CANFD_RX_MB_NONE,
            // Specify which FIFO(s) to send filtered messages to. Multiple FIFOs can be OR'd together. 
            .fifo_select_flags = CANFD_RX_FIFO_0,
        }
    }
};

/*******************************************************************************************************************//**
 * main() is generated by the RA Configuration editor and is used to generate threads if an RTOS is used.  This function
 * is called by main() when no RTOS is used.
 **********************************************************************************************************************/
void hal_entry(void)
{
    uint32_t time_out = WAIT_TIME;                                    //time out	
    uint8_t  can_tx_msg[CAN_FRAME_TRANSMIT_DATA_BYTES] = "TX_MESG0";  //data to be load in tx_frame while transmitting
    uint8_t  can_rx_msg[CAN_FRAME_TRANSMIT_DATA_BYTES] = "RX_MESG0";  //data to be load in rx_frame while acknowledging
	
	
    //Code taken from Renesas github documentation https://renesas.github.io/fsp/group___c_a_n_f_d.html
   
  	fsp_err_t err;
		
    /* Initialize the CAN module */
    err = R_CANFD_Open(&g_canfd0_ctrl, &g_canfd0_cfg);
    /* Handle any errors. This function should be defined by the user. */
    if(FSP_SUCCESS != err)
		{
		   while(1);
		}
		
		
	  //Use the external loopback mode for initial testing
		err = R_CANFD_ModeTransition(&g_canfd0_ctrl,CAN_OPERATION_MODE_NORMAL,CAN_TEST_MODE_DISABLED);
		if(FSP_SUCCESS != err)
    {
			while(1);
    }
		
		//Make sure the callback is linkedcan_callback_args_t * p_args
		err = R_CANFD_CallbackSet(&g_canfd0_ctrl, canfd0_callback, NULL, NULL);
	  if(FSP_SUCCESS != err)
		{
		   while(1);
		}
			
    /* Setup frame to write to CAN ID 0x20 */
    g_can_tx_frame.id               = CAN_EXAMPLE_ID;
    g_can_tx_frame.id_mode          = CAN_ID_MODE_STANDARD;
    g_can_tx_frame.type             = CAN_FRAME_TYPE_DATA;
    g_can_tx_frame.data_length_code = 8;
    g_can_tx_frame.options          = 0;
		
		
		memcpy((uint8_t*)&g_can_tx_frame.data[ZERO], (uint8_t*)&can_tx_msg[ZERO], CAN_FRAME_TRANSMIT_DATA_BYTES);
		
		while(1)
		{
			 if(SendResponse)
			 {	
				  SendResponse = false;
          /* Send data on the bus */
				 				 
          err = R_CANFD_Write(&g_canfd0_ctrl, CANFD_TX_MB_0, &g_can_tx_frame);
    
		      if(FSP_SUCCESS != err)
		      {
		        while(1);
		      }
       
					if(g_can_tx_frame.data[7] >= 0x39) //Increment the last byte for each messaged received
					{
					  g_can_tx_frame.data[7] = 0x30; 					
					}
					else
					{
					  g_can_tx_frame.data[7] ++; 					
					}
			    /* Wait for a transmit callback event */		
          while ((true != b_can_tx) && (--time_out));
          if (RESET_VALUE == time_out)
          {
				    R_BSP_SoftwareDelay(10,BSP_DELAY_UNITS_MILLISECONDS);
				    time_out = WAIT_TIME;
          }
          b_can_tx = false;
			   		 
			 }				
			
			 //Periodically get the state of the CAN for debugging	
			 err = R_CANFD_InfoGet (&g_canfd0_ctrl, &can_info);			 
			 if(FSP_SUCCESS != err)
		   {
		      while(1);
		   }
				
			 
			 if(b_can_rx) //Check if we have received data
			 {
           // Reset flag bit 
			     b_can_rx = false;
           SendResponse = true;				 
				 
				  // if received data is same as transmitted data then acknowledge with RX_MSG as received successful
          if (RESET_VALUE == strncmp((char*)&g_can_rx_frame.data[ZERO], (char*)&can_tx_msg[ZERO], CAN_FRAME_TRANSMIT_DATA_BYTES))
					{
					 	 g_can_rx_frame.id               = CAN_EXAMPLE_ID;
             g_can_rx_frame.type             = CAN_FRAME_TYPE_DATA;
             g_can_rx_frame.data_length_code = CAN_FRAME_TRANSMIT_DATA_BYTES;

             // copy the rx_data frame as RX_MSG 
             memcpy((uint8_t*)&g_can_rx_frame.data[ZERO], (uint8_t*)&can_rx_msg[ZERO], CAN_FRAME_TRANSMIT_DATA_BYTES);    
           
					}											 
				  		
          // Transmit the rx data frame as acknowledging the data transfer is successful 
          err = R_CANFD_Write (&g_canfd0_ctrl, CANFD_TX_MB_0, &g_can_rx_frame);
             
					// Error trap 
          if (FSP_SUCCESS != err)
          {
					  while(1);
          }
								
          // wait for transmit flag bit to set
          while ((true != b_can_tx) && (--time_out));
          if (RESET_VALUE == time_out)
          {
						 R_BSP_SoftwareDelay(10,BSP_DELAY_UNITS_MILLISECONDS);
					   time_out = WAIT_TIME;
          }
					
					b_can_tx = false;		
					
					// Reset the rx frame data 
          memset((uint8_t*)&g_can_rx_frame.data[ZERO],RESET_VALUE,CAN_FRAME_TRANSMIT_DATA_BYTES);
					
			 }			
		}

#if BSP_TZ_SECURE_BUILD
    /* Enter non-secure code */
    R_BSP_NonSecureEnter();
#endif
		
}

void canfd0_callback (can_callback_args_t * p_args)
{
	
    switch (p_args->event)
    {
        case CAN_EVENT_RX_COMPLETE:    /* Receive complete event. */
        {
            /* Read received frame */
            memcpy(&g_can_rx_frame, p_args->p_frame, sizeof(can_frame_t));
					  b_can_rx = true;
            /* Handle event */
            break;
        }
        case CAN_EVENT_TX_COMPLETE:    /* Transmit complete event. */
        {
            /* Handle event */
					  b_can_tx = true;
            break;
        }
        case CAN_EVENT_ERR_GLOBAL:                        /* Global error. */
        case CAN_EVENT_ERR_CHANNEL:                       /* Channel error. */
        {
            /* Get error status */
            g_err_status = (canfd_error_t) p_args->error; /* Check error code with canfd_error_t. */
            /* Handle event */					
            break;
        }
        default:
        {
            break;
        }
    }
}

/*******************************************************************************************************************//**
 * This function is called at various points during the startup process.  This implementation uses the event that is
 * called right before main() to set up the pins.
 *
 * @param[in]  event    Where at in the start up process the code is currently at
 **********************************************************************************************************************/
void R_BSP_WarmStart (bsp_warm_start_event_t event)
{
    if (BSP_WARM_START_RESET == event)
    {
#if BSP_FEATURE_FLASH_LP_VERSION != 0

        /* Enable reading from data flash. */
        R_FACI_LP->DFLCTL = 1U;

        /* Would normally have to wait tDSTOP(6us) for data flash recovery. Placing the enable here, before clock and
         * C runtime initialization, should negate the need for a delay since the initialization will typically take more than 6us. */
#endif
    }

    if (BSP_WARM_START_POST_C == event)
    {
        /* C runtime environment and system clocks are setup. */

        /* Configure pins. */
        R_IOPORT_Open(&g_ioport_ctrl, g_ioport.p_cfg);
    }
}

#if BSP_TZ_SECURE_BUILD

BSP_CMSE_NONSECURE_ENTRY void template_nonsecure_callable ();

/* Trustzone Secure Projects require at least one nonsecure callable function in order to build (Remove this if it is not required to build). */
BSP_CMSE_NONSECURE_ENTRY void template_nonsecure_callable ()
{

}
#endif
