#include "hal_data.h"
//#include "application_main.h"

#include "pwm_curr_fdbk.h"


FSP_CPP_HEADER
void R_BSP_WarmStart(bsp_warm_start_event_t event);
FSP_CPP_FOOTER

alphabeta_t volt_alpha_beta;


/*******************************************************************************************************************//**
 * main() is generated by the RA Configuration editor and is used to generate threads if an RTOS is used.  This function
 * is called by main() when no RTOS is used.
 **********************************************************************************************************************/
void hal_entry(void)
{
    /* TODO: add your own code here */
	
	volt_alpha_beta.alpha = 0;
	volt_alpha_beta.beta = 0;

	R_POEG_Open(g_poeg0.p_ctrl, g_poeg0.p_cfg);
	
	R_GPT_THREE_PHASE_Open(g_three_phase0.p_ctrl,g_three_phase0.p_cfg);
	//R_GPT_THREE_PHASE_DutyCycleSet(g_three_phase0.p_ctrl,&duty_abc);
	PWMC_SetPhaseVoltage(volt_alpha_beta);
	R_GPT_THREE_PHASE_Start (g_three_phase0.p_ctrl);
	
	while(true)
	{
		//R_GPT_THREE_PHASE_DutyCycleSet(g_three_phase0.p_ctrl,&duty_abc);
		PWMC_SetPhaseVoltage(volt_alpha_beta);
		//(void) R_POEG_StatusGet(&g_poeg0_ctrl, &status);
		//R_GPT_THREE_PHASE_Stop(g_three_phase0.p_ctrl);				
	}
	
		R_GPT_THREE_PHASE_Stop(g_three_phase0.p_ctrl);
		R_GPT_THREE_PHASE_Close(g_three_phase0.p_ctrl);
	

#if BSP_TZ_SECURE_BUILD
    /* Enter non-secure code */
    R_BSP_NonSecureEnter();
#endif
}

/*******************************************************************************************************************//**
 * This function is called at various points during the startup process.  This implementation uses the event that is
 * called right before main() to set up the pins.
 *
 * @param[in]  event    Where at in the start up process the code is currently at
 **********************************************************************************************************************/
void R_BSP_WarmStart (bsp_warm_start_event_t event)
{
    if (BSP_WARM_START_RESET == event)
    {
#if BSP_FEATURE_FLASH_LP_VERSION != 0

        /* Enable reading from data flash. */
        R_FACI_LP->DFLCTL = 1U;

        /* Would normally have to wait tDSTOP(6us) for data flash recovery. Placing the enable here, before clock and
         * C runtime initialization, should negate the need for a delay since the initialization will typically take more than 6us. */
#endif
    }

    if (BSP_WARM_START_POST_C == event)
    {
        /* C runtime environment and system clocks are setup. */

        /* Configure pins. */
        R_IOPORT_Open(&g_ioport_ctrl, g_ioport.p_cfg);
    }
}

#if BSP_TZ_SECURE_BUILD

BSP_CMSE_NONSECURE_ENTRY void template_nonsecure_callable ();

/* Trustzone Secure Projects require at least one nonsecure callable function in order to build (Remove this if it is not required to build). */
BSP_CMSE_NONSECURE_ENTRY void template_nonsecure_callable ()
{

}
#endif
